## config/boards/shields/mcorne/Kconfig.defconfig
```kconfig
# Copyright (c) 2020 The ZMK Contributors
# SPDX-License-Identifier: MIT

config ZMK_KEYBOARD_NAME
	default "MCorne"

if SHIELD_MCORNE_RIGHT

config ZMK_SPLIT_ROLE_CENTRAL
	default y

endif

if SHIELD_MCORNE_LEFT || SHIELD_MCORNE_RIGHT

config ZMK_SPLIT
	default y

endif
```

## config/boards/shields/mcorne/Kconfig.shield
```kconfig
# Copyright (c) 2020 The ZMK Contributors
# SPDX-License-Identifier: MIT

config SHIELD_MCORNE_LEFT
    def_bool $(shields_list_contains,mcorne_left)

config SHIELD_MCORNE_RIGHT
    def_bool $(shields_list_contains,mcorne_right)
```
